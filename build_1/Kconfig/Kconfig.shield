## build_1/Kconfig/Kconfig.shield
```kconfig
osource "C:/Users/User/Downloads/Montre_Connectee/boards/shields/*/Kconfig.shield"
osource "C:/ncs/v2.8.0/nrf/boards/shields/*/Kconfig.shield"
```

## build_1/Montre_Connectee/Kconfig/Kconfig.shield.defconfig
```kconfig
osource "C:/Users/User/Downloads/Montre_Connectee/boards/shields/*/Kconfig.defconfig"
osource "C:/ncs/v2.8.0/nrf/boards/shields/*/Kconfig.defconfig"
```
